## asus-kgpe-d16-firmware/zephyr/boards/aspeed/kgpe_d16_bmc/Kconfig.kgpe_d16_bmc
```kconfig
# SPDX-License-Identifier: Apache-2.0

config BOARD_KGPE_D16_BMC
	select SOC_AST2050
```

## asus-kgpe-d16-firmware/zephyr/boards/aspeed/kgpe_d16_bmc/board.yml
```yaml
board:
  name: kgpe_d16_bmc
  full_name: ASUS KGPE-D16 BMC (ASPEED AST2050)
  vendor: aspeed
  socs:
    - name: ast2050
```

## asus-kgpe-d16-firmware/zephyr/drivers/gpio/Kconfig
```kconfig
# ASPEED AST2050 (G3) GPIO driver.
# SPDX-License-Identifier: Apache-2.0

# Only offered once the GPIO subsystem itself is enabled (mirrors the in-tree
# drivers/gpio "if GPIO" menu). Auto-enables when a matching devicetree node is
# present and left okay.
if GPIO

config GPIO_ASPEED_G3
	bool "ASPEED AST2050 (G3) GPIO driver"
	default y
	depends on DT_HAS_ASPEED_AST2050_GPIO_ENABLED
	help
	  Enable the GPIO driver for the ASPEED AST2050 (G3, ARM926EJ-S) BMC SoC.
	  Each 32-pin Aspeed GPIO set (ABCD, EFGH, ...) is a separate devicetree
	  node / Zephyr GPIO port whose reg points at that set's data-value
	  register (direction register at reg + 0x04).

config GPIO_W83601G
	bool "Winbond W83601G I2C GPIO expander driver"
	default y
	depends on DT_HAS_WINBOND_W83601G_GPIO_ENABLED
	depends on I2C
	help
	  Enable the GPIO-controller driver for the Winbond W83601G I2C GPIO
	  expander (KGPE-D16 DIMM-LED expanders U27/U28 on the BMC's I2C5 engine).
	  Exposes each expander as a 16-pin Zephyr GPIO port (Port 1 = 0..7, Port 2
	  = 8..15) driven over the Zephyr I2C API.

config GPIO_W83601G_INIT_PRIORITY
	int "W83601G GPIO expander init priority"
	default 75
	depends on GPIO_W83601G
	help
	  Device init priority. Must be greater than CONFIG_I2C_INIT_PRIORITY so the
	  parent I2C controller is initialised first.

endif # GPIO
```

## asus-kgpe-d16-firmware/zephyr/dts/bindings/gpio/aspeed,ast2050-gpio.yaml
```yaml
# ASPEED AST2050 (G3) GPIO bank controller binding.
# SPDX-License-Identifier: Apache-2.0

description: |
  ASPEED AST2050 (G3) GPIO controller bank.

  The AST2050 / AST2400 (G3/G4) GPIO block at 0x1E780000 groups its pins into
  32-pin "sets" (ABCD, EFGH, IJKL, MNOP, QRST, UVWX, YZAAAB). Each set exposes a
  32-bit "data value" register and a 32-bit "direction" register (0 = input,
  1 = output) at fixed, per-set offsets:

    set ABCD    data 0x000  dir 0x004
    set EFGH    data 0x020  dir 0x024
    set IJKL    data 0x070  dir 0x074
    set MNOP    data 0x078  dir 0x07C
    set QRST    data 0x080  dir 0x084
    set UVWX    data 0x088  dir 0x08C
    set YZAAAB  data 0x1E0  dir 0x1E4

  A Zephyr GPIO port is a single 32-bit word (gpio_port_value_t), so each Aspeed
  32-pin set is modelled as its own controller node. A node's "reg" points at
  that set's data-value register; the direction register is at reg + 0x04.

compatible: "aspeed,ast2050-gpio"

include: [gpio-controller.yaml, base.yaml]

properties:
  reg:
    required: true

  ngpios:
    description: |
      Number of pins in this bank. One Aspeed set is a single 32-bit Zephyr
      GPIO port, so this is at most 32 (inherited default: 32).

gpio-cells:
  - pin
  - flags
```

## asus-kgpe-d16-firmware/zephyr/dts/bindings/gpio/winbond,w83601g-gpio.yaml
```yaml
# Winbond W83601G I2C GPIO expander binding.
# SPDX-License-Identifier: Apache-2.0

description: |
  Winbond W83601G I2C GPIO expander (KGPE-D16 DIMM-LED expanders U27/U28). Exposed
  as a 15-pin Zephyr GPIO controller: Port 1 = pins 0..7 (GP10-GP17), Port 2 =
  pins 8..14 (GP20-GP26, only 7 pins; the Port-2 register bit 7 is reserved). Set
  ngpios = <15>. See drivers/gpio/gpio_w83601g.c.

compatible: "winbond,w83601g-gpio"

include: [i2c-device.yaml, gpio-controller.yaml]

properties:
  "#gpio-cells":
    const: 2

gpio-cells:
  - pin
  - flags
```

## asus-kgpe-d16-firmware/zephyr/dts/bindings/i2c/aspeed,ast2050-i2c.yaml
```yaml
# ASPEED AST2050 (G3) I2C controller (one engine / one bus) binding.
# SPDX-License-Identifier: Apache-2.0

description: |
  ASPEED AST2050 (G3) I2C controller engine.

  The AST2050 / AST2400 (G3/G4) I2C block lives at controller base 0x1E78A000
  and is built from a 0x40-byte global register block followed by up to 7
  per-engine (per-bus) register blocks, each 0x40 bytes, at
  0x1E78A000 + 0x40 * (engine + 1) for engine 0..6:

    engine 0   0x1E78A040
    engine 1   0x1E78A080
    engine 2   0x1E78A0C0
    engine 3   0x1E78A100
    engine 4   0x1E78A140
    engine 5   0x1E78A180
    engine 6   0x1E78A1C0

  Each engine is an independent I2C master/slave; a Zephyr I2C controller node
  models one engine, and its "reg" points at that engine's per-bus register
  block (NOT the global block). Register offsets within the block (legacy "old
  mode", the AST2050 reset default): FUN_CTRL 0x00, AC_TIMING1 0x04,
  AC_TIMING2 0x08, INTR_CTRL 0x0C, INTR_STS 0x10, CMD 0x14, DEV_ADDR 0x18,
  POOL_CTRL 0x1C, BYTE_BUF 0x20 (from QEMU include/hw/i2c/aspeed_i2c.h and the
  vendor U-Boot arch-aspeed/aspeed_i2c.h).

  The whole 7-engine block is held in reset at power-on by SCU04[2]; the driver
  de-asserts it (see drivers/i2c/i2c_aspeed_g3.c).

compatible: "aspeed,ast2050-i2c"

include: [i2c-controller.yaml, base.yaml]

properties:
  reg:
    required: true

  clock-frequency:
    description: |
      Target SCL frequency in Hz. This minimal driver programs the fixed vendor
      AC-timing value for ~100 kHz regardless (see the driver); the property is
      accepted for forward compatibility with a per-speed divider computation.
```

## asus-kgpe-d16-firmware/zephyr/dts/bindings/rtc/aspeed,ast2050-rtc.yaml
```yaml
# ASPEED AST2050 (G3) counter-style RTC binding.
# SPDX-License-Identifier: Apache-2.0

description: |
  ASPEED AST2050 (G3) counter-style Real-Time Clock at 0x1E781000 (datasheet
  §24). Holds a packed binary sec/min/hour/day counter (no month/year) loaded
  via a 0x5A RESTART magic. See drivers/rtc/rtc_aspeed_g3.c.

compatible: "aspeed,ast2050-rtc"

include: [base.yaml, rtc-device.yaml]

properties:
  reg:
    required: true
```

## asus-kgpe-d16-firmware/zephyr/dts/bindings/sensor/amd,sbtsi.yaml
```yaml
# AMD SB-TSI (Side-Band Temperature Sensor Interface) I2C binding.
# SPDX-License-Identifier: Apache-2.0

description: |
  AMD SB-TSI processor thermal sensor.

  The Side-Band Temperature Sensor Interface exposes an AMD CPU's die
  temperature as an SMBus/I2C byte-register device. On the ASUS KGPE-D16 BMC the
  two CPU sockets present one SB-TSI each on AST2050 I2C engine 3 (DT i2c3 =
  schematic "I2C4"): 0x4C = socket P0, 0x4D = socket P1 (see
  asus-kgpe-d16-firmware/zephyr/dts/aspeed/ast2050.dtsi, node i2c3, and the QEMU
  kgpe-d16-bmc machine wiring in hw/arm/aspeed.c kgpe_d16_bmc_i2c_init lines
  619-638). On real silicon these only answer when the host CPU is powered; the
  QEMU model always returns the seeded value.

  Register model this driver relies on (QEMU hw/sensor/sbtsi.c, corroborated by
  Linux drivers/hwmon/sbtsi_temp.c):
    - integer temperature register 0x01 (TEMP_INT), whole degrees C, sbtsi.c
      lines 37 / 69;
    - fractional register 0x10 (TEMP_DEC): bits[7:5] hold the fraction in
      0.125 C steps, sbtsi.c lines 42 / 47-49 / 70-71;
    - config register 0x03 bit5 = read-order (int-first vs dec-first), sbtsi.c
      line 39 (reset value 0x00 = int-first, line 157);
    - Temperature = TEMP_INT*1000 + (TEMP_DEC>>5)*125 millidegrees C, sbtsi.c
      lines 18-19 / 69-71.

compatible: "amd,sbtsi"

include: [sensor-device.yaml, i2c-device.yaml]

properties:
  reg:
    required: true
    description: I2C device address (0x4C = socket P0, 0x4D = P1 on the KGPE-D16 BMC).
```

## asus-kgpe-d16-firmware/zephyr/dts/bindings/sensor/nuvoton,w83795.yaml
```yaml
# Nuvoton/Winbond W83795G hardware-monitor (I2C) binding.
# SPDX-License-Identifier: Apache-2.0

description: |
  Nuvoton/Winbond W83795G hardware monitor.

  A bank-switched I2C "H/W monitoring IC" with 21 voltage inputs, analog +
  DTS temperatures and 8 fan-tach / PWM channels. On the ASUS KGPE-D16 BMC it
  sits on AST2050 I2C engine 1 at 7-bit address 0x2F (see
  asus-kgpe-d16-firmware/zephyr/dts/aspeed/ast2050.dtsi, node i2c1, and the QEMU
  kgpe-d16-bmc machine wiring in hw/arm/aspeed.c kgpe_d16_bmc_i2c_init).

  Register model this driver relies on (QEMU hw/sensor/w83795.c):
    - bank-select register 0x00 (low 3 bits pick the bank; measurement windows
      live in bank 0), w83795_do_write() lines 266-268;
    - chip-id register 0xFE == 0x79, w83795_do_read() lines 207-208;
    - fan-tach high byte at 0x2E (fan1) + shared VRLSB latch 0x3C[7:4] low
      nibble, w83795_set_fan()/w83795_do_read() lines 111-119 / 240-242;
    - CPU thermal-diode temperature high byte at 0x21 + VRLSB 0x3C[7:6]
      quarter-degrees, w83795_set_temp() lines 122-132.

compatible: "nuvoton,w83795"

include: [sensor-device.yaml, i2c-device.yaml]

properties:
  reg:
    required: true
    description: I2C device address (0x2F on the KGPE-D16 BMC).
```

## asus-kgpe-d16-firmware/zephyr/dts/bindings/watchdog/aspeed,ast2050-wdt.yaml
```yaml
# ASPEED AST2050 (G3) watchdog timer binding.
# SPDX-License-Identifier: Apache-2.0

description: |
  ASPEED AST2050 (G3) watchdog timer.

  The AST2050 / AST1100 integrates ONE 32-bit programmable watchdog timer at
  0x1E785000 (the AST2400/G4 grew a second at 0x1E785020; the G3 has only one).
  It is a down-counter clocked from either PCLK or a fixed 1 MHz reference that,
  on timeout, resets the SoC (or raises an interrupt). Register block is 0x20
  bytes; offsets within it (from the vendor hwreg.h / QEMU
  hw/watchdog/wdt_aspeed.c):

    0x00  counter / status   (R: current down-count)
    0x04  reload             (RW: value reloaded into the counter)
    0x08  restart (magic)    (W: write 0x4755 to reload the counter = "kick")
    0x0C  control            ([0] enable, [1] reset-system, [2] interrupt,
                              [4] clock 0=PCLK/1=1 MHz, [6:5] reset mode)

  See drivers/watchdog/wdt_aspeed_g3.c for the driver.

compatible: "aspeed,ast2050-wdt"

include: [base.yaml]

properties:
  reg:
    required: true
```

## asus-kgpe-d16-firmware/zephyr/soc/aspeed/Kconfig.defconfig
```kconfig
# SPDX-License-Identifier: Apache-2.0

if SOC_FAMILY_ASPEED

configdefault SOC_EARLY_INIT_HOOK
	default y

endif # SOC_FAMILY_ASPEED

rsource "*/Kconfig.defconfig"
```

## asus-kgpe-d16-firmware/zephyr/soc/aspeed/Kconfig.soc
```kconfig
# ASPEED AST2050 SoC family.
# SPDX-License-Identifier: Apache-2.0

config SOC_FAMILY_ASPEED
	bool
	help
	  ASPEED BMC SoCs (ARM926EJ-S G3 generation: AST2050 / AST1100).

config SOC_FAMILY
	default "aspeed" if SOC_FAMILY_ASPEED

rsource "*/Kconfig.soc"
```

## asus-kgpe-d16-firmware/zephyr/soc/aspeed/ast2050/Kconfig.soc
```kconfig
# ASPEED AST2050 (G3) series.
# SPDX-License-Identifier: Apache-2.0

config SOC_SERIES_AST2050
	bool
	select SOC_FAMILY_ASPEED
	help
	  ASPEED AST2050 / AST1100 (ARM926EJ-S, ARMv5TEJ) server BMC SoC.

config SOC_SERIES
	default "ast2050" if SOC_SERIES_AST2050

config SOC_AST2050
	bool
	select SOC_SERIES_AST2050

config SOC
	default "ast2050" if SOC_AST2050
```

## asus-kgpe-d16-firmware/zephyr/soc/aspeed_g3/Kconfig.defconfig
```kconfig
# SPDX-License-Identifier: Apache-2.0

if SOC_FAMILY_ASPEED_G3

configdefault SOC_EARLY_INIT_HOOK
	default y

endif # SOC_FAMILY_ASPEED_G3

rsource "*/Kconfig.defconfig"
```
